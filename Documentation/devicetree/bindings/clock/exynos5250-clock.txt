## drivers/media/pci/mgb4/Kconfig
```kconfig
# SPDX-License-Identifier: GPL-2.0-only
config VIDEO_MGB4
	tristate "Digiteq Automotive MGB4 support"
	depends on VIDEO_DEV && PCI && I2C && SPI && MTD && IIO
	depends on COMMON_CLK
	depends on XILINX_XDMA
	depends on (I2C_XILINX && SPI_XILINX) || COMPILE_TEST
	select VIDEOBUF2_DMA_SG
	select IIO_BUFFER
	select IIO_TRIGGERED_BUFFER
	help
	  This is a video4linux driver for Digiteq Automotive MGB4 grabber
	  cards.

	  To compile this driver as a module, choose M here: the
	  module will be called mgb4.
```

## drivers/net/hyperv/Kconfig
```kconfig
# SPDX-License-Identifier: GPL-2.0-only
config HYPERV_NET
	tristate "Microsoft Hyper-V virtual network driver"
	depends on HYPERV
	select NLS
	select UCS2_STRING
	help
	  Select this option to enable the Hyper-V virtual network driver.
```

## drivers/reset/Kconfig
```kconfig
config RESET_CONTROLLER
	bool

menu "Reset Controller Support"
	depends on ARCH_HAS_RESET_CONTROLLER || COMPILE_TEST

config RESET_SOCFPGA
	bool "Altera SOCFPGA reset controller" if COMPILE_TEST
	default ARCH_SOCFPGA
	select RESET_CONTROLLER

config RESET_BERLIN
	bool "Marvell Berlin reset controller" if COMPILE_TEST
	default ARCH_BERLIN
	select RESET_CONTROLLER

config RESET_SUNXI
	bool "Allwinner reset controller" if COMPILE_TEST
	default ARCH_SUNXI
	select RESET_CONTROLLER

config RESET_OXNAS
	bool

config TI_SYSCON_RESET
	tristate "TI SYSCON Reset Driver"
	depends on HAS_IOMEM
	select MFD_SYSCON
	help
	  This enables the reset driver support for TI devices with
	  memory-mapped reset registers as part of a syscon device node. If
	  you wish to use the reset framework for such memory-mapped devices,
	  say Y here. Otherwise, say N.

source "drivers/reset/sti/Kconfig"
source "drivers/reset/hisilicon/Kconfig"

endmenu
```

## drivers/reset/sti/Kconfig
```kconfig
if ARCH_STI || COMPILE_TEST

config RESET_STI_SYSCFG
	bool
	select RESET_CONTROLLER

config RESET_STIH415
	bool "STmicroelectronics STiH415 reset controller" if COMPILE_TEST
	select RESET_STI_SYSCFG

config RESET_STIH416
	bool "STmicroelectronics STiH416 reset controller" if COMPILE_TEST
	select RESET_STI_SYSCFG

config RESET_STIH407
	bool "STmicroelectronics STiH407 reset controller" if COMPILE_TEST
	select RESET_STI_SYSCFG

endif
```

## drivers/scsi/esas2r/Kconfig
```kconfig
config SCSI_ESAS2R
	tristate "ATTO Technology's ExpressSAS RAID adapter driver"
	depends on PCI && SCSI
	depends on Y2038_UNSAFE
	---help---
	  This driver supports the ATTO ExpressSAS R6xx SAS/SATA RAID controllers.
```

## drivers/staging/i4l/Kconfig
```kconfig
#
# Old ISDN4Linux config
#
menu "Old ISDN4Linux (deprecated)"
	depends on ISDN_I4L

source "drivers/staging/i4l/hisax/Kconfig"

endmenu
```
