## Documentation/devicetree/bindings/clock/exynos5250-clock.txt
```
* Samsung Exynos5250 Clock Controller

The Exynos5250 clock controller generates and supplies clock to various
controllers within the Exynos5250 SoC.

Required Properties:

- compatible: should be one of the following.
  - "samsung,exynos5250-clock" - controller compatible with Exynos5250 SoC.

- reg: physical base address of the controller and length of memory mapped
  region.

- #clock-cells: should be 1.

- samsung,armclk-divider-table: when the frequency of the APLL is changed
  the divider clocks in CMU_CPU clock domain also need to be updated. These
  divider clocks have SoC specific divider clock output requirements for a
  specific APLL clock speeds. When APLL clock rate is changed, these divider
  clocks are reprogrammed with pre-determined values in order to maintain the
  SoC specific divider clock outputs. This property lists the divider values
  for divider clocks in the CMU_CPU block for supported APLL clock speeds.
  The format of each entry included in the arm-frequency-table should be
  as defined below

      cell #1: expected arm clock parent frequency
      cell #2 ~ cell #9: value of clock divider in the following order
	       cpud_ratio, acp_ratio, periph_ratio, atb_ratio,
               pclk_dbg_ratio, apll_ratio, copy_ratio, hpm_ratio

- samsung,armclk-cells: defines the number of cells in
  samsung,armclk-divider-table property. The value of this property should be 9.


The following is the list of clocks generated by the controller. Each clock is
assigned an identifier and client nodes use this identifier to specify the
clock which they consume.


       [Core Clocks]

  Clock			ID
  ----------------------------

  fin_pll		1

  [Clock Gate for Special Clocks]

  Clock			ID
  ----------------------------

  sclk_cam_bayer	128
  sclk_cam0		129
  sclk_cam1		130
  sclk_gscl_wa		131
  sclk_gscl_wb		132
  sclk_fimd1		133
  sclk_mipi1		134
  sclk_dp		135
  sclk_hdmi		136
  sclk_pixel		137
  sclk_audio0		138
  sclk_mmc0		139
  sclk_mmc1		140
  sclk_mmc2		141
  sclk_mmc3		142
  sclk_sata		143
  sclk_usb3		144
  sclk_jpeg		145
  sclk_uart0		146
  sclk_uart1		147
  sclk_uart2		148
  sclk_uart3		149
  sclk_pwm		150
  sclk_audio1		151
  sclk_audio2		152
  sclk_spdif		153
  sclk_spi0		154
  sclk_spi1		155
  sclk_spi2		156
  div_i2s1		157
  div_i2s2		158
  sclk_hdmiphy		159
  div_pcm0		160


   [Peripheral Clock Gates]

  Clock			ID
  ----------------------------

  gscl0			256
  gscl1			257
  gscl2			258
  gscl3			259
  gscl_wa		260
  gscl_wb		261
  smmu_gscl0		262
  smmu_gscl1		263
  smmu_gscl2		264
  smmu_gscl3		265
  mfc			266
  smmu_mfcl		267
  smmu_mfcr		268
  rotator		269
  jpeg			270
  mdma1			271
  smmu_rotator		272
  smmu_jpeg		273
  smmu_mdma1		274
  pdma0			275
  pdma1			276
  sata			277
  usbotg		278
  mipi_hsi		279
  sdmmc0		280
  sdmmc1		281
  sdmmc2		282
  sdmmc3		283
  sromc			284
  usb2			285
  usb3			286
  sata_phyctrl		287
  sata_phyi2c		288
  uart0			289
  uart1			290
  uart2			291
  uart3			292
  uart4			293
  i2c0			294
  i2c1			295
  i2c2			296
  i2c3			297
  i2c4			298
  i2c5			299
  i2c6			300
  i2c7			301
  i2c_hdmi		302
  adc			303
  spi0			304
  spi1			305
  spi2			306
  i2s1			307
  i2s2			308
  pcm1			309
  pcm2			310
  pwm			311
  spdif			312
  ac97			313
  hsi2c0		314
  hsi2c1		315
  hs12c2		316
  hs12c3		317
  chipid		318
  sysreg		319
  pmu			320
  cmu_top		321
  cmu_core		322
  cmu_mem		323
  tzpc0			324
  tzpc1			325
  tzpc2			326
  tzpc3			327
  tzpc4			328
  tzpc5			329
  tzpc6			330
  tzpc7			331
  tzpc8			332
  tzpc9			333
  hdmi_cec		334
  mct			335
  wdt			336
  rtc			337
  tmu			338
  fimd1			339
  mie1			340
  dsim0			341
  dp			342
  mixer			343
  hdmi			344
  g2d			345
  mdma0			346
  smmu_mdma0		347


   [Clock Muxes]

  Clock			ID
  ----------------------------
  mout_hdmi		1024

All available clocks are defined as preprocessor macros in
dt-bindings/clock/exynos5250.h header and can be used in device
tree sources.

Example 1: An example of a clock controller node is listed below.

	clock: clock-controller@0x10010000 {
		compatible = "samsung,exynos5250-clock";
		reg = <0x10010000 0x30000>;
		#clock-cells = <1>;

		samsung,armclk-cells = <9>;
		samsung,armclk-divider-table = <1700000 3 7 7 7 3 5 0 2>,
					       <1600000 3 7 7 7 1 4 0 2>,
					       <1500000 2 7 7 7 1 4 0 2>,
					       <1400000 2 7 7 6 1 4 0 2>,
					       <1300000 2 7 7 6 1 3 0 2>,
					       <1200000 2 7 7 5 1 3 0 2>,
					       <1100000 3 7 7 5 1 3 0 2>,
					       <1000000 1 7 7 4 1 2 0 2>,
					       < 900000 1 7 7 4 1 2 0 2>,
					       < 800000 1 7 7 4 1 2 0 2>,
					       < 700000 1 7 7 3 1 1 0 2>,
					       < 600000 1 7 7 3 1 1 0 2>,
					       < 500000 1 7 7 2 1 1 0 2>,
					       < 400000 1 7 7 2 1 1 0 2>,
					       < 300000 1 7 7 1 1 1 0 2>,
					       < 200000 1 7 7 1 1 1 0 2>;

	};

Example 2: UART controller node that consumes the clock generated by the clock
	   controller. Refer to the standard clock bindings for information
	   about 'clocks' and 'clock-names' property.

	serial@13820000 {
		compatible = "samsung,exynos4210-uart";
		reg = <0x13820000 0x100>;
		interrupts = <0 54 0>;
		clocks = <&clock CLK_UART2>, <&clock CLK_SCLK_UART2>;
		clock-names = "uart", "clk_uart_baud0";
	};
```

## Documentation/devicetree/bindings/ufs/ufshcd-pltfrm.txt
```
* Universal Flash Storage (UFS) Host Controller

UFSHC nodes are defined to describe on-chip UFS host controllers.
Each UFS controller instance should have its own node.

Required properties:
- compatible		: must contain "jedec,ufs-1.1", "jedec,ufs-2.0",
			  or "jedec,ufshci-3.0", and may also list one
			  or more of the following, as well as others
			  specified in derived bindings:
					  "qcom,msm8994-ufshc"
					  "qcom,msm8996-ufshc"
					  "qcom,ufshc"
- interrupts        : <interrupt mapping for UFS host controller IRQ>
- reg               : <registers mapping>

Optional properties:
- phys                  : phandle to UFS PHY node
- phy-names             : the string "ufsphy" when is found in a node, along
                          with "phys" attribute, provides phandle to UFS PHY node
- vdd-hba-supply        : phandle to UFS host controller supply regulator node
- vcc-supply            : phandle to VCC supply regulator node
- vccq-supply           : phandle to VCCQ supply regulator node
- vccq2-supply          : phandle to VCCQ2 supply regulator node
- vcc-supply-1p8        : For embedded UFS devices, valid VCC range is 1.7-1.95V
                          or 2.7-3.6V. This boolean property when set, specifies
			  to use low voltage range of 1.7-1.95V. Note for external
			  UFS cards this property is invalid and valid VCC range is
			  always 2.7-3.6V.
- vcc-max-microamp      : specifies max. load that can be drawn from vcc supply
- vccq-max-microamp     : specifies max. load that can be drawn from vccq supply
- vccq2-max-microamp    : specifies max. load that can be drawn from vccq2 supply
- <name>-fixed-regulator : boolean property specifying that <name>-supply is a fixed regulator

- clocks                : List of phandle and clock specifier pairs
- clock-names           : List of clock input name strings sorted in the same
                          order as the clocks property. Standard clocks include:
	"core_clk"	: The clock associated with the ufshcd IP block
	"ref_clk"	: The reference clock for the external interface to the device,
			  typically operating at 19.2 MHz.
	"iface_clk"	: The clock for the CPU-side interface to the ufshcd memory
			  mapped registers
	"bus_clk"	: The interface clock for bus master data transfers on to
			  main memory.

- resets		: List of specifiers of associated reset lines
- reset-names		: An idenfifier for each reset line. The name "rst" should
			  be used for the line that resets the ufshci block during
			  startup.

- freq-table-hz		: Array of <min max> operating frequencies stored in the same
                          order as the clocks property. If this property is not
			  defined or a value in the array is "0" then it is assumed
			  that the frequency is set by the parent clock or a
			  fixed rate clock source.
-lanes-per-direction	: number of lanes available per direction - either 1 or 2.
			  Note that it is assume same number of lanes is used both
			  directions at once. If not specified, default is 2 lanes per direction.

Note: If above properties are not defined it can be assumed that the supply
regulators or clocks are always on.

Example:
	ufshc@fc598000 {
		compatible = "jedec,ufs-1.1";
		reg = <0xfc598000 0x800>;
		interrupts = <0 28 0>;

		vdd-hba-supply = <&xxx_reg0>;
		vdd-hba-fixed-regulator;
		vcc-supply = <&xxx_reg1>;
		vcc-supply-1p8;
		vccq-supply = <&xxx_reg2>;
		vccq2-supply = <&xxx_reg3>;
		vcc-max-microamp = 500000;
		vccq-max-microamp = 200000;
		vccq2-max-microamp = 200000;

		clocks = <&core 0>, <&ref 0>, <&iface 0>;
		clock-names = "core_clk", "ref_clk", "iface_clk";
		resets = <&reset 0 1>;
		reset-names = "rst";
		freq-table-hz = <100000000 200000000>, <0 0>, <0 0>;
		phys = <&ufsphy1>;
		phy-names = "ufsphy";
	};
```

## arch/arm/mach-exynos/Kconfig
```kconfig
# arch/arm/mach-exynos/Kconfig
#
# Copyright (c) 2010-2011 Samsung Electronics Co., Ltd.
#		http://www.samsung.com/
#
# Licensed under GPLv2

# Configuration options for the EXYNOS4

config ARCH_S5PV210
	bool "Samsung S5PV210/S5PC110" if ARCH_MULTI_V7
	select ARCH_HAS_HOLES_MEMORYMODEL
	select ARCH_REQUIRE_GPIOLIB
	select ARM_AMBA
	select ARM_CPU_SUSPEND if PM
	select ARM_VIC
	select CLKSRC_SAMSUNG_PWM
	select COMMON_CLK_SAMSUNG
	select GENERIC_IRQ_CHIP
	select HAVE_S3C2410_I2C if I2C
	select HAVE_S3C2410_WATCHDOG if WATCHDOG
	select HAVE_S3C_RTC if RTC_CLASS
	select NO_IOPORT_MAP
	select PINCTRL
	select PINCTRL_EXYNOS
	select PL330_DMA if DMADEVICES
	help
	  Samsung S5PV210/S5PC110 series based systems

config CPU_S5PV210
	def_bool ARCH_S5PV210

config PLAT_S5P
	def_bool ARCH_S5PV210 || ARCH_EXYNOS

menuconfig ARCH_EXYNOS
	bool "Samsung EXYNOS" if ARCH_MULTI_V7
	select ARCH_HAS_BANDGAP
	select ARCH_HAS_HOLES_MEMORYMODEL
	select ARCH_REQUIRE_GPIOLIB
	select ARM_AMBA
	select ARM_CPU_SUSPEND
	select ARM_GIC
	select COMMON_CLK_SAMSUNG
	select GENERIC_IRQ_CHIP
	select HAVE_ARM_SCU if SMP
	select HAVE_S3C2410_I2C if I2C
	select HAVE_S3C2410_WATCHDOG if WATCHDOG
	select HAVE_S3C_RTC if RTC_CLASS
	select NO_IOPORT_MAP
	select PINCTRL
	select PINCTRL_EXYNOS
	select PM_GENERIC_DOMAINS if PM
	select SRAM
	select MFD_SYSCON
	help
	  Support for SAMSUNG EXYNOS SoCs (EXYNOS4/5)

if ARCH_EXYNOS

config ARCH_EXYNOS3
	bool "SAMSUNG EXYNOS3"
	select ARM_CPU_SUSPEND if PM
	help
	  Samsung EXYNOS3 (Cortex-A7) SoC based systems

config ARCH_EXYNOS_AUTOSELECT
	def_bool y
	select ARCH_EXYNOS4 if !ARCH_EXYNOS5 && !ARCH_EXYNOS3
	select CPU_EXYNOS4210 if ARCH_EXYNOS4 && !SOC_EXYNOS4212 && !SOC_EXYNOS4412
	select SOC_EXYNOS5250 if ARCH_EXYNOS5 && !SOC_EXYNOS5420 && !SOC_EXYNOS5440

config ARCH_EXYNOS4
	bool "SAMSUNG EXYNOS4"
	default y
	select ARM_CPU_SUSPEND if PM_SLEEP
	select CLKSRC_SAMSUNG_PWM if CPU_EXYNOS4210
	select CPU_EXYNOS4210
	select GIC_NON_BANKED
	select KEYBOARD_SAMSUNG if INPUT_KEYBOARD
	select MIGHT_HAVE_CACHE_L2X0
	help
	  Samsung EXYNOS4 (Cortex-A9) SoC based systems

config ARCH_EXYNOS5
	bool "SAMSUNG EXYNOS5"
	default y
	help
	  Samsung EXYNOS5 (Cortex-A15/A7) SoC based systems

comment "EXYNOS SoCs"

config SOC_EXYNOS3250
	bool "SAMSUNG EXYNOS3250"
	default y
	depends on ARCH_EXYNOS3

config CPU_EXYNOS4210
	bool "SAMSUNG EXYNOS4210"
	default y
	depends on ARCH_EXYNOS4

config SOC_EXYNOS4212
	bool "SAMSUNG EXYNOS4212"
	default y
	depends on ARCH_EXYNOS4

config SOC_EXYNOS4412
	bool "SAMSUNG EXYNOS4412"
	default y
	depends on ARCH_EXYNOS4

config SOC_EXYNOS4415
	bool "SAMSUNG EXYNOS4415"
	default y
	depends on ARCH_EXYNOS4

config SOC_EXYNOS5250
	bool "SAMSUNG EXYNOS5250"
	default y
	depends on ARCH_EXYNOS5

config SOC_EXYNOS5260
	bool "SAMSUNG EXYNOS5260"
	default y
	depends on ARCH_EXYNOS5

config SOC_EXYNOS5410
	bool "SAMSUNG EXYNOS5410"
	default y
	depends on ARCH_EXYNOS5

config SOC_EXYNOS5420
	bool "SAMSUNG EXYNOS5420"
	default y
	depends on ARCH_EXYNOS5

config SOC_EXYNOS5440
	bool "SAMSUNG EXYNOS5440"
	default y
	depends on ARCH_EXYNOS5
	select ARCH_DMA_ADDR_T_64BIT if ARM_LPAE
	select HAVE_ARM_ARCH_TIMER
	select AUTO_ZRELADDR
	select MIGHT_HAVE_PCI
	select PCI_DOMAINS if PCI
	select PINCTRL_EXYNOS5440
	select PM_OPP
	help
	  Enable EXYNOS5440 SoC support

config SOC_EXYNOS5800
	bool "SAMSUNG EXYNOS5800"
	default y
	depends on SOC_EXYNOS5420

config EXYNOS5420_MCPM
	bool "Exynos5420 Multi-Cluster PM support"
	depends on MCPM && SOC_EXYNOS5420 && PM_SLEEP
	select ARM_CCI
	select ARM_CPU_SUSPEND
	help
	  This is needed to provide CPU and cluster power management
	  on Exynos5420 implementing big.LITTLE.

config EXYNOS_CPU_SUSPEND
	bool
	select ARM_CPU_SUSPEND
	default PM_SLEEP || ARM_EXYNOS_CPUIDLE

endif

config PLAT_S5P
	def_bool ARCH_EXYNOS || ARCH_S5PV210

if PLAT_S5P
menu "Samsung Power Management options"

config S5P_PM_DEBUG
	bool "S3C2410 PM Suspend debug"
	depends on PM && DEBUG_KERNEL && DEBUG_S5P_UART
	help
	  Say Y here if you want verbose debugging from the PM Suspend and
	  Resume code. See <file:Documentation/arm/Samsung-S3C24XX/Suspend.txt>
	  for more information.

config S5P_PM_CHECK
	bool "S3C2410 PM Suspend Memory CRC"
	depends on PM
	select CRC32
	help
	  Enable the PM code's memory area checksum over sleep. This option
	  will generate CRCs of all blocks of memory, and store them before
	  going to sleep. The blocks are then checked on resume for any
	  errors.

	  Note, this can take several seconds depending on memory size
	  and CPU speed.

	  See <file:Documentation/arm/Samsung-S3C24XX/Suspend.txt>

config S5P_PM_CHECK_CHUNKSIZE
	int "S3C2410 PM Suspend CRC Chunksize (KiB)"
	depends on PM && S5P_PM_CHECK
	default 64
	help
	  Set the chunksize in Kilobytes of the CRC for checking memory
	  corruption over suspend and resume. A smaller value will mean that
	  the CRC data block will take more memory, but wil identify any
	  faults with better precision.

	  See <file:Documentation/arm/Samsung-S3C24XX/Suspend.txt>

config DEBUG_S5P_UART
	depends on PLAT_S5P
	int
	default "0" if DEBUG_S3C_UART0
	default "1" if DEBUG_S3C_UART1
	default "2" if DEBUG_S3C_UART2
	default "3" if DEBUG_S3C_UART3

endmenu
endif
```

## arch/arm/mach-gemini/Kconfig
```kconfig
menuconfig ARCH_GEMINI
	bool "Cortina Systems Gemini" if ARCH_MULTI_V4
	select CLKSRC_MMIO
	select CPU_FA526
	select GENERIC_CLOCKEVENTS
	select GPIOLIB
	help
	  Support for the Cortina Systems Gemini family SoCs

if ARCH_GEMINI

config MACH_NAS4220B
	bool "Raidsonic NAS-4220-B"
	select GEMINI_MEM_SWAP
	help
	  Say Y here if you intend to run this kernel on a
	  Raidsonic NAS-4220-B.

config MACH_RUT100
	bool "Teltonika RUT100"
	select GEMINI_MEM_SWAP
	help
	  Say Y here if you intend to run this kernel on a
	  Teltonika 3G Router RUT100.

config MACH_WBD111
	bool "Wiliboard WBD-111"
	select GEMINI_MEM_SWAP
	help
	  Say Y here if you intend to run this kernel on a
	  Wiliboard WBD-111.

config MACH_WBD222
        bool "Wiliboard WBD-222"
        select GEMINI_MEM_SWAP
        help
          Say Y here if you intend to run this kernel on a
          Wiliboard WBD-222.

config GEMINI_MEM_SWAP
	bool "Gemini memory is swapped"
	help
	  Say Y here if Gemini memory is swapped by bootloader.

endif
```
