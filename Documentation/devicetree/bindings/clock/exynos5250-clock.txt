## arch/arm/mach-msm/Kconfig
```kconfig
menuconfig ARCH_MSM
	bool "Qualcomm MSM (legacy)"
	select ARCH_REQUIRE_GPIOLIB
	select CLKSRC_QCOM
	select MSM_PROC_COMM
	select MSM_SMD
	help
	  Support for Qualcomm MSM/QSD based systems.  This runs on the
	  apps processor of the MSM/QSD and depends on a shared memory
	  interface to the modem processor which runs the baseband
	  stack and controls some vital subsystems
	  (clock and power control, etc).

if ARCH_MSM

config ARCH_MSM7X00A
	bool

config ARCH_MSM7X30
	bool
	select MSM_GPIOMUX
	select MSM_VIC

config ARCH_QSD8X50
	bool
	select MSM_GPIOMUX
	select MSM_VIC

config MSM_SOC_REV_A
	bool

config MSM_VIC
	bool

config MSM_PROC_COMM
	bool

config MSM_SMD
	bool

config MSM_GPIOMUX
	bool

config MACH_HALIBUT
	depends on ARCH_MULTI_V6
	select ARCH_MSM7X00A
	bool "Halibut Board (QCT SURF7201A)"
	help
	  Support for the Qualcomm SURF7201A eval board.

config MACH_TROUT
	depends on ARCH_MULTI_V6
	select ARCH_MSM7X00A
	bool "HTC Dream (aka trout)"
	help
	  Support for the HTC Dream, T-Mobile G1, Android ADP1 devices.

config MACH_MSM7X30_SURF
	depends on ARCH_MULTI_V7
	select ARCH_MSM7X30
	bool "MSM7x30 SURF"
	help
	  Support for the Qualcomm MSM7x30 SURF eval board.

config MACH_QSD8X50_SURF
	depends on ARCH_MULTI_V7
	select ARCH_QSD8X50
	bool "QSD8x50 SURF"
	help
	  Support for the Qualcomm QSD8x50 SURF eval board.

config MACH_QSD8X50A_ST1_5
	depends on ARCH_MULTI_V7
	select ARCH_QSD8X50
	bool "QSD8x50A ST1.5"
	select MSM_SOC_REV_A
	help
	  Support for the Qualcomm ST1.5.

endif
```

## arch/arm/mach-npcm/Kconfig
```kconfig
menuconfig ARCH_NPCM
	bool "Nuvoton NPCM Architecture" if ARCH_MULTI_V7
	select ARCH_REQUIRE_GPIOLIB
	select USE_OF
	select PINCTRL
	select PINCTRL_NPCM7XX

if ARCH_NPCM

comment "NPCM7XX CPU type"

config ARCH_NPCM750
	depends on ARCH_NPCM
	bool "Support for NPCM750 BMC CPU (Poleg)"
	select HAVE_ARM_SCU
	select HAVE_ARM_TWD if SMP
	select ARM_ERRATA_720789
	select ARM_ERRATA_754322
	select ARM_ERRATA_764369
	select ARM_ERRATA_794072
	select PL310_ERRATA_588369
	select PL310_ERRATA_727915
	select NPCM750_TIMER
	select MFD_SYSCON
	help
	  Support for NPCM750 BMC CPU (Poleg).

	  Nuvoton NPCM750 BMC based on the Cortex A9.

endif
```

## arch/arm/mach-orion/Kconfig
```kconfig
# SPDX-License-Identifier: GPL-2.0-only
config PLAT_ORION
	bool
	select CLKSRC_MMIO
	select COMMON_CLK
	select GENERIC_IRQ_CHIP
	select GPIOLIB
	select IRQ_DOMAIN
	select MVEBU_MBUS

config PLAT_ORION_LEGACY
	bool
	select PLAT_ORION

menuconfig ARCH_DOVE
	bool "Marvell Dove" if ARCH_MULTI_V7
	select CPU_PJ4
	select PINCTRL
	select PINCTRL_DOVE
	select PLAT_ORION_LEGACY
	select PM_GENERIC_DOMAINS if PM
	help
	  Support for the Marvell Dove SoC 88AP510

if ARCH_DOVE

config MACH_DOVE_DB
	bool "Marvell DB-MV88AP510 Development Board"
	select I2C_BOARDINFO if I2C
	help
	  Say 'Y' here if you want your kernel to support the
	  Marvell DB-MV88AP510 Development Board.

config MACH_CM_A510
	bool "CompuLab CM-A510 Board"
	help
	  Say 'Y' here if you want your kernel to support the
	  CompuLab CM-A510 Board.

endif

menuconfig ARCH_MV78XX0
	bool "Marvell MV78xx0"
	depends on ARCH_MULTI_V5
	select CPU_FEROCEON
	select FORCE_PCI
	select PLAT_ORION_LEGACY
	help
	  Support for the following Marvell MV78xx0 series SoCs:
	  MV781x0, MV782x0.

if ARCH_MV78XX0

config MACH_DB78X00_BP
	bool "Marvell DB-78x00-BP Development Board"
	help
	  Say 'Y' here if you want your kernel to support the
	  Marvell DB-78x00-BP Development Board.

config MACH_RD78X00_MASA
	bool "Marvell RD-78x00-mASA Reference Design"
	help
	  Say 'Y' here if you want your kernel to support the
	  Marvell RD-78x00-mASA Reference Design.

config MACH_TERASTATION_WXL
	bool "Buffalo WLX (Terastation Duo) NAS"
	help
	  Say 'Y' here if you want your kernel to support the
	  Buffalo WXL Nas.

endif

menuconfig ARCH_ORION5X
	bool "Marvell Orion"
	depends on MMU && ARCH_MULTI_V5
	select CPU_FEROCEON
	select FORCE_PCI
	select PHYLIB if NETDEVICES
	select PLAT_ORION_LEGACY
	help
	  Support for the following Marvell Orion 5x series SoCs:
	  Orion-1 (5181), Orion-VoIP (5181L), Orion-NAS (5182),
	  Orion-2 (5281), Orion-1-90 (6183).

if ARCH_ORION5X

config ARCH_ORION5X_DT
	bool "Marvell Orion5x Flattened Device Tree"
	select ORION_CLK
	select ORION_IRQCHIP
	select ORION_TIMER
	select PINCTRL
	select PINCTRL_ORION
	help
	  Say 'Y' here if you want your kernel to support the
	  Marvell Orion5x using flattened device tree.

config MACH_DB88F5281
	bool "Marvell Orion-2 Development Board"
	select I2C_BOARDINFO if I2C
	help
	  Say 'Y' here if you want your kernel to support the
	  Marvell Orion-2 (88F5281) Development Board

config MACH_RD88F5182
	bool "Marvell Orion-NAS Reference Design"
	select I2C_BOARDINFO if I2C
	help
	  Say 'Y' here if you want your kernel to support the
	  Marvell Orion-NAS (88F5182) RD2

config MACH_RD88F5182_DT
	bool "Marvell Orion-NAS Reference Design (Flattened Device Tree)"
	select ARCH_ORION5X_DT
	select I2C_BOARDINFO if I2C
	help
	  Say 'Y' here if you want your kernel to support the Marvell
	  Orion-NAS (88F5182) RD2, Flattened Device Tree.

config MACH_KUROBOX_PRO
	bool "KuroBox Pro"
	select I2C_BOARDINFO if I2C
	help
	  Say 'Y' here if you want your kernel to support the
	  KuroBox Pro platform.

config MACH_DNS323
	bool "D-Link DNS-323"
	select I2C_BOARDINFO if I2C
	help
	  Say 'Y' here if you want your kernel to support the
	  D-Link DNS-323 platform.

config MACH_TS209
	bool "QNAP TS-109/TS-209"
	help
	  Say 'Y' here if you want your kernel to support the
	  QNAP TS-109/TS-209 platform.

config MACH_TERASTATION_PRO2
	bool "Buffalo Terastation Pro II/Live"
	help
	  Say 'Y' here if you want your kernel to support the
	  Buffalo Terastation Pro II/Live platform.

config MACH_LINKSTATION_PRO
	bool "Buffalo Linkstation Pro/Live"
	select I2C_BOARDINFO if I2C
	help
	  Say 'Y' here if you want your kernel to support the
	  Buffalo Linkstation Pro/Live platform. Both v1 and
	  v2 devices are supported.

config MACH_LINKSTATION_MINI
	bool "Buffalo Linkstation Mini (Flattened Device Tree)"
	select ARCH_ORION5X_DT
	help
	  Say 'Y' here if you want your kernel to support the
	  Buffalo Linkstation Mini (LS-WSGL) platform.

config MACH_LINKSTATION_LS_HGL
	bool "Buffalo Linkstation LS-HGL"
	select I2C_BOARDINFO if I2C
	help
	  Say 'Y' here if you want your kernel to support the
	  Buffalo Linkstation LS-HGL platform.

config MACH_TS409
	bool "QNAP TS-409"
	help
	  Say 'Y' here if you want your kernel to support the
	  QNAP TS-409 platform.

config MACH_WRT350N_V2
	bool "Linksys WRT350N v2"
	help
	  Say 'Y' here if you want your kernel to support the
	  Linksys WRT350N v2 platform.

config MACH_TS78XX
	bool "Technologic Systems TS-78xx"
	help
	  Say 'Y' here if you want your kernel to support the
	  Technologic Systems TS-78xx platform.

config MACH_MV2120
	bool "HP Media Vault mv2120"
	help
	  Say 'Y' here if you want your kernel to support the
	  HP Media Vault mv2120 or mv5100.

config MACH_D2NET_DT
	bool "LaCie d2 Network / Big Disk Network (Flattened Device Tree)"
	select ARCH_ORION5X_DT
	help
	  Say 'Y' here if you want your kernel to support the
	  LaCie d2 Network NAS.

config MACH_NET2BIG
	bool "LaCie 2Big Network"
	select I2C_BOARDINFO if I2C
	help
	  Say 'Y' here if you want your kernel to support the
	  LaCie 2Big Network NAS.

config MACH_MSS2_DT
	bool "Maxtor Shared Storage II (Flattened Device Tree)"
	select ARCH_ORION5X_DT
	help
	  Say 'Y' here if you want your kernel to support the
	  Maxtor Shared Storage II platform.

config MACH_WNR854T
	bool "Netgear WNR854T"
	help
	  Say 'Y' here if you want your kernel to support the
	  Netgear WNR854T platform.

config MACH_RD88F5181L_GE
	bool "Marvell Orion-VoIP GE Reference Design"
	help
	  Say 'Y' here if you want your kernel to support the
	  Marvell Orion-VoIP GE (88F5181L) RD.

config MACH_RD88F5181L_FXO
	bool "Marvell Orion-VoIP FXO Reference Design"
	help
	  Say 'Y' here if you want your kernel to support the
	  Marvell Orion-VoIP FXO (88F5181L) RD.

config MACH_RD88F6183AP_GE
	bool "Marvell Orion-1-90 AP GE Reference Design"
	help
	  Say 'Y' here if you want your kernel to support the
	  Marvell Orion-1-90 (88F6183) AP GE RD.

endif
```

## arch/arm/mach-rda/Kconfig
```kconfig
# SPDX-License-Identifier: GPL-2.0-only
menuconfig ARCH_RDA
	bool "RDA Micro SoCs"
	depends on ARCH_MULTI_V7
	select RDA_INTC
	select RDA_TIMER
	select MIGHT_HAVE_CACHE_L2X0
	help
	  This enables support for the RDA Micro 8810PL SoC family.
```

## arch/arm/mach-w90x900/Kconfig
```kconfig
menuconfig ARCH_NUC900
	bool "Nuvoton CPU_W90P910/NUC9xx support"
	depends on ARCH_MULTI_V5

if ARCH_NUC900 || ARCH_W90X900_SINGLE

config SOC_NUC970
	bool "Nuvoton NUC970 SoC support"
	select ARCH_W90X900
	select GENERIC_IRQ_CHIP
	select MFD_SYSCON
	select NUC900_TIMER
	select SOC_NUC900
	help
	  Support for NUC970 of Nuvoton NUC900 SoCs.
	  The NUC970 series runs up to 300 MHz, with 16 KB I-cache,
	  16 KB D-cache and MMU, 56KB embedded SRAM and 16 KB Internal
	  Boot ROM for booting from USB, NAND and SPI FLASH.
	  Detailed information please check the following link:
	  https://github.com/zswan/nuc900-document/blob/master/
	  NUC970_TechnicalReferenceManual_EN_Rev1.30.pdf

config ARCH_W90X900
	def_bool ARCH_W90X900_SINGLE || ARCH_NUC900

config CPU_W90P910
	bool
	select ARCH_W90X900
	help
	  Support for W90P910 of Nuvoton W90X900 CPUs.

config CPU_NUC950
	bool
	select ARCH_W90X900
	help
	  Support for NUCP950 of Nuvoton NUC900 CPUs.

config CPU_NUC960
	bool
	select ARCH_W90X900
	help
	  Support for NUCP960 of Nuvoton NUC900 CPUs.

menu "W90P910 Machines"

config MACH_W90P910EVB
	bool "Nuvoton W90P910 Evaluation Board"
	default y
	select CPU_W90P910
	help
	   Say Y here if you are using the Nuvoton W90P910EVB

endmenu

menu "NUC950 Machines"

config MACH_W90P950EVB
	bool "Nuvoton NUC950 Evaluation Board"
	select CPU_NUC950
	help
	   Say Y here if you are using the Nuvoton NUC950EVB

endmenu

menu "NUC960 Machines"

config MACH_W90N960EVB
	bool "Nuvoton NUC960 Evaluation Board"
	select CPU_NUC960
	help
	   Say Y here if you are using the Nuvoton NUC960EVB

endmenu

config MACH_W90X900_AUTO
	def_bool y
	select MACH_W90P910EVB if !(MACH_W90P950EVB || MACH_W90N960EVB)

endif
```

## arch/sh/boards/Kconfig
```kconfig
# SPDX-License-Identifier: GPL-2.0
menu "Board support"

config SOLUTION_ENGINE
	bool

config SH_ALPHA_BOARD
	bool

config SH_DEVICE_TREE
	bool
	select OF
	select OF_EARLY_FLATTREE
	select TIMER_OF
	select COMMON_CLK
	select GENERIC_CALIBRATE_DELAY

config SH_JCORE_SOC
	bool "J-Core SoC"
	select SH_DEVICE_TREE
	select CLKSRC_JCORE_PIT
	select JCORE_AIC
	depends on CPU_J2
	help
	  Select this option to include drivers core components of the
	  J-Core SoC, including interrupt controllers and timers.

config SH_DREAMCAST
	bool "Dreamcast"
	select HAVE_PCI
	depends on CPU_SUBTYPE_SH7091
	help
	  Select Dreamcast if configuring for a SEGA Dreamcast.
	  More information at <http://www.linux-sh.org>

config SH_SH03
	bool "Interface CTP/PCI-SH03"
	depends on CPU_SUBTYPE_SH7751
	select CPU_HAS_IPR_IRQ
	select HAVE_PCI
	help
	  CTP/PCI-SH03 is a CPU module computer that is produced
	  by Interface Corporation.
	  More information at <http://www.interface.co.jp>

config SH_SECUREEDGE5410
	bool "SecureEdge5410"
	depends on CPU_SUBTYPE_SH7751R
	select CPU_HAS_IPR_IRQ
	select HAVE_PCI
	help
	  Select SecureEdge5410 if configuring for a SnapGear SH board.
	  This includes both the OEM SecureEdge products as well as the
	  SME product line.

config SH_LANDISK
	bool "LANDISK"
	depends on CPU_SUBTYPE_SH7751R
	select HAVE_PCI
	help
	  I-O DATA DEVICE, INC. "LANDISK Series" support.

config SH_TITAN
	bool "TITAN"
	depends on CPU_SUBTYPE_SH7751R
	select CPU_HAS_IPR_IRQ
	select HAVE_PCI
	help
	  Select Titan if you are configuring for a Nimble Microsystems
	  NetEngine NP51R.

config SH_LBOX_RE2
	bool "L-BOX RE2"
	depends on CPU_SUBTYPE_SH7751R
	select HAVE_PCI
	help
	  Select L-BOX RE2 if configuring for the NTT COMWARE L-BOX RE2.

config SH_SH2007
	bool "SH-2007 board"
	select NO_IOPORT_MAP
	select REGULATOR_FIXED_VOLTAGE if REGULATOR
	depends on CPU_SUBTYPE_SH7780
	help
	  SH-2007 is a single-board computer based around SH7780 chip
	  intended for embedded applications.
	  It has an Ethernet interface (SMC9118), direct connected
	  Compact Flash socket, two serial ports and PC-104 bus.
	  More information at <http://sh2000.sh-linux.org>.

config SH_APSH4A3A
	bool "AP-SH4A-3A"
	select SH_ALPHA_BOARD
	select REGULATOR_FIXED_VOLTAGE if REGULATOR
	depends on CPU_SUBTYPE_SH7785
	help
	  Select AP-SH4A-3A if configuring for an ALPHAPROJECT AP-SH4A-3A.

config SH_APSH4AD0A
	bool "AP-SH4AD-0A"
	select SH_ALPHA_BOARD
	select HAVE_PCI
	select REGULATOR_FIXED_VOLTAGE if REGULATOR
	depends on CPU_SUBTYPE_SH7786
	help
	  Select AP-SH4AD-0A if configuring for an ALPHAPROJECT AP-SH4AD-0A.

endif

endmenu
```

## drivers/gpu/drm/amd/amdkfd/Kconfig
```kconfig
# SPDX-License-Identifier: MIT
#
# Heterogeneous system architecture configuration
#

config HSA_AMD
	bool "HSA kernel driver for AMD GPU devices"
	depends on DRM_AMDGPU && (X86_64 || ARM64 || PPC64)
	depends on AMD_IOMMU_V2=y || DRM_AMDGPU=m
	select HMM_MIRROR
	select MMU_NOTIFIER
	select DRM_AMDGPU_USERPTR
	help
	  Enable this if you want to use HSA features on AMD GPU devices.

config HSA_AMD_SVM
	bool "Enable HMM-based shared virtual memory manager"
	depends on HSA_AMD && DEVICE_PRIVATE
	default y
	select HMM_MIRROR
	select MMU_NOTIFIER
	help
	  Enable this to use unified memory and managed memory in HIP. This
	  memory manager supports two modes of operation. One based on
	  preemptions and one based on page faults. To enable page fault
	  based memory management on most GFXv9 GPUs, set the module
	  parameter amdgpu.noretry=0.
```

## drivers/gpu/drm/gma500/Kconfig
```kconfig
# SPDX-License-Identifier: GPL-2.0-only
config DRM_GMA500
	tristate "Intel GMA500/600/3600/3650 KMS Framebuffer"
	depends on DRM && PCI && X86 && MMU
	depends on ACPI_VIDEO || !ACPI
	select DRM_KMS_HELPER
	help
	  Say yes for an experimental 2D KMS framebuffer driver for the
	  Intel GMA500 (Poulsbo), Intel GMA600 (Moorestown/Oak Trail) and
	  Intel GMA3600/3650 (Cedar Trail).
```

## drivers/gpu/drm/vmwgfx/Kconfig
```kconfig
# SPDX-License-Identifier: GPL-2.0
config DRM_VMWGFX
	tristate "DRM driver for VMware Virtual GPU"
	depends on DRM && PCI && X86 && MMU
	select DRM_TTM
	select MAPPING_DIRTY_HELPERS
	# Only needed for the transitional use of drm_crtc_init - can be removed
	# again once vmwgfx sets up the primary plane itself.
	select DRM_KMS_HELPER
	help
	  Choose this option if you would like to run 3D acceleration
	  in a VMware virtual machine.
	  This is a KMS enabled DRM driver for the VMware SVGA2
	  virtual hardware.
	  The compiled module will be called "vmwgfx.ko".

config DRM_VMWGFX_FBCON
	bool "Enable framebuffer console under vmwgfx"
	depends on DRM_VMWGFX
	depends on FB=y || FB=DRM_VMWGFX
	select FB_DEFERRED_IO
	select FB_CFB_FILLRECT
	select FB_CFB_COPYAREA
	select FB_CFB_IMAGEBLIT
	help
	   Choose this option if you are shipping a new vmwgfx
	   userspace driver that supports using the kernel driver
	   and you have framebuffer support enabled.
```

## drivers/media/pci/intel/Kconfig
```kconfig
# SPDX-License-Identifier: GPL-2.0-only

source "drivers/media/pci/intel/ipu3/Kconfig"
source "drivers/media/pci/intel/ivsc/Kconfig"

config IPU_BRIDGE
	tristate "Intel IPU Sensors Bridge"
	depends on I2C && ACPI
	help
	  The sensors bridge is used by multiple other drivers
	  and may be used optionally there.
```
